# file: usbAudio.ioc
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Mcu.Family=STM32F4
Mcu.Name=STM32F407V(E-G)Tx
Mcu.Package=LQFP100
NVIC.PriorityGroup=NVIC_PRIORITYGROUP_4
PH0-OSC_IN.Mode=HSE-External-Oscillator
PH0-OSC_IN.Signal=RCC_OSC_IN
PH1-OSC_OUT.Mode=HSE-External-Oscillator
PH1-OSC_OUT.Signal=RCC_OSC_OUT
ProjectManager.HeapSize=0x2000
ProjectManager.StackSize=0x2000
ProjectManager.TargetToolchain=STM32CubeIDE
RCC.48MHZClocksFreq_Value=84000000
RCC.AHBFreq_Value=168000000
RCC.APB1CLKDivider=RCC_HCLK_DIV4
RCC.APB1Freq_Value=42000000
RCC.APB1TimFreq_Value=84000000
RCC.APB2CLKDivider=RCC_HCLK_DIV2
RCC.APB2Freq_Value=84000000
RCC.APB2TimFreq_Value=168000000
RCC.CortexFreq_Value=168000000
RCC.HCLKFreq_Value=168000000
RCC.HSE_VALUE=8000000
RCC.HSI_VALUE=16000000
RCC.LSE_VALUE=32768
RCC.PLLM=4
RCC.PLLN=168
RCC.PLLSourceVirtual=RCC_PLLSOURCE_HSE
RCC.SYSCLKFreq_VALUE=168000000
RCC.SYSCLKSource=RCC_SYSCLKSOURCE_PLLCLK
RCC.VCOOutputFreq_Value=336000000
board=custom

// file: Core/Src/main.c
/* USER CODE BEGIN Header */
/**
  ******************************************************************************
  * @file           : main.c
  * @brief          : Main program body
  ******************************************************************************
  * @attention
  *
  * Copyright (c) 2023 STMicroelectronics.
  * All rights reserved.
  *
  * This software is licensed under terms that can be found in the LICENSE file
  * in the root directory of this software component.
  * If no LICENSE file comes with this software, it is provided AS-IS.
  *
  ******************************************************************************
  */
/* USER CODE END Header */
#include "main.h"
/* USER CODE BEGIN Includes */
#include "cube_hal.h"
#include "sineTable.h"
#include "math.h"
/* USER CODE END Includes */

/* USER CODE BEGIN PTD */
USBD_HandleTypeDef hUSBDDevice;
extern USBD_AUDIO_ItfTypeDef  USBD_AUDIO_fops;

volatile int16_t usbBuffer[48*2];
/* USER CODE END PTD */

#define BUTTON_PIN GPIO_PIN_0
#define BUTTON_PORT GPIOA

#define DEBOUNCE_DELAY_MS 20

volatile uint8_t buttonState = 0;

/* USER CODE BEGIN PM */
//frequency will be doubled when button pressed
uint32_t variableSinFreq = 1;

//number of channels
#define AUDIO_IN_CHANNELS 2
//sampling frequency in Hz
#define AUDIO_IN_SAMPLING_FREQUENCY 48000
//polling period in ms
#define HOST_POLL_REQUEST_PERIOD	1
//time between two consecutive samples in sec
#define TIME_BW_CONSECUTIVE_SAMPLES	(double)1 / (AUDIO_IN_SAMPLING_FREQUENCY / HOST_POLL_REQUEST_PERIOD)
#define SINE_TABLE_SIZE 20000

void generateSineForUsbAudioClass(int16_t* sineArr, uint32_t sinFreq)
{
	  static double t = 0;
	  for(uint16_t i = 0; i < (AUDIO_IN_SAMPLING_FREQUENCY / (1000 / HOST_POLL_REQUEST_PERIOD)); i ++)
	  {
			t += TIME_BW_CONSECUTIVE_SAMPLES;

			//prevent overflow
			if(t >= (double)1 / sinFreq)
			{
			  t -= (double) 1 / sinFreq;
			}

			//channel-1
			sineArr[i * AUDIO_IN_CHANNELS] = sineLookupTable[(uint64_t)(t * SINE_TABLE_SIZE * sinFreq)];

			//channel-2 same signal will appear but with 180 degree phase difference
			sineArr[i * AUDIO_IN_CHANNELS + 1] = sineLookupTable[(uint64_t)(t * SINE_TABLE_SIZE * sinFreq + (SINE_TABLE_SIZE/2)) % SINE_TABLE_SIZE];
	  }
}

/* USER CODE END PM */

void SystemClock_Config(void);
static void MX_GPIO_Init(void);

int main(void)
{

  /* MCU Configuration--------------------------------------------------------*/

  /* Reset of all peripherals, Initializes the Flash interface and the Systick. */
  HAL_Init();

  /* Configure the system clock */
  SystemClock_Config();

  /* Initialize all configured peripherals */
  MX_GPIO_Init();
  /* USER CODE BEGIN 2 */
  /* Initialize USB descriptor basing on channels number and sampling frequency */
  //fill descriptors
  USBD_AUDIO_Init_Microphone_Descriptor(&hUSBDDevice, AUDIO_IN_SAMPLING_FREQUENCY, AUDIO_IN_CHANNELS);
  /* Init Device Library */
  //init usb low level
  USBD_Init(&hUSBDDevice, &AUDIO_Desc, 0);
  /* Add Supported Class */
  //ilk fonksiyon ile descriptorleri initialize edilen audio class, hUSBDDevice structurune veriliyor.
  USBD_RegisterClass(&hUSBDDevice, &USBD_AUDIO);
  /* Add Interface callbacks for AUDIO Class */
  USBD_AUDIO_RegisterInterface(&hUSBDDevice, &USBD_AUDIO_fops);
  /* Start Device Process */
  USBD_Start(&hUSBDDevice);

  /* USER CODE END 2 */

  /* Infinite loop */
  /* USER CODE BEGIN WHILE */
  uint8_t buttonStatus = 0;
  while (1)
  {
	if ((GPIOA->IDR & GPIO_IDR_ID0) == 1)
	{
		// Button is pressed
		//Debounce
		HAL_Delay(20);
		if ((GPIOA->IDR & GPIO_IDR_ID0) == 1)
		{
			if(buttonStatus == 0)
			{
				if(variableSinFreq < (SINE_TABLE_SIZE / 2))	//check for Nyquist theorem
				{
					variableSinFreq *= 2;
				}
				else
				{
					//close USB
					USBD_Stop(&hUSBDDevice);
				}
				buttonStatus = 1;
			}
		}
	}
	else
	{
		//button released
		buttonStatus = 0;
	}

    /* USER CODE END WHILE */

  }
}

void SystemClock_Config(void)
{
  RCC_OscInitTypeDef RCC_OscInitStruct = {0};
  RCC_ClkInitTypeDef RCC_ClkInitStruct = {0};

  /** Configure the main internal regulator output voltage
  */
  __HAL_RCC_PWR_CLK_ENABLE();
  __HAL_PWR_VOLTAGESCALING_CONFIG(PWR_REGULATOR_VOLTAGE_SCALE1);

  /** Initializes the RCC Oscillators according to the specified parameters
  * in the RCC_OscInitTypeDef structure.
  */
  RCC_OscInitStruct.OscillatorType = RCC_OSCILLATORTYPE_HSE;
  RCC_OscInitStruct.HSEState = RCC_HSE_ON;
  RCC_OscInitStruct.PLL.PLLState = RCC_PLL_ON;
  RCC_OscInitStruct.PLL.PLLSource = RCC_PLLSOURCE_HSE;
  RCC_OscInitStruct.PLL.PLLM = 4;
  RCC_OscInitStruct.PLL.PLLN = 168;
  RCC_OscInitStruct.PLL.PLLP = RCC_PLLP_DIV2;
  RCC_OscInitStruct.PLL.PLLQ = 7;
  if (HAL_RCC_OscConfig(&RCC_OscInitStruct) != HAL_OK)
  {
    Error_Handler();
  }

  /** Initializes the CPU, AHB and APB buses clocks
  */
  RCC_ClkInitStruct.ClockType = RCC_CLOCKTYPE_HCLK|RCC_CLOCKTYPE_SYSCLK
                              |RCC_CLOCKTYPE_PCLK1|RCC_CLOCKTYPE_PCLK2;
  RCC_ClkInitStruct.SYSCLKSource = RCC_SYSCLKSOURCE_PLLCLK;
  RCC_ClkInitStruct.AHBCLKDivider = RCC_SYSCLK_DIV1;
  RCC_ClkInitStruct.APB1CLKDivider = RCC_HCLK_DIV4;
  RCC_ClkInitStruct.APB2CLKDivider = RCC_HCLK_DIV2;

  if (HAL_RCC_ClockConfig(&RCC_ClkInitStruct, FLASH_LATENCY_5) != HAL_OK)
  {
    Error_Handler();
  }
}

static void MX_GPIO_Init(void)
{
  /* GPIO Ports Clock Enable */
  __HAL_RCC_GPIOH_CLK_ENABLE();

  // Enable GPIOA clock
   RCC->AHB1ENR |= RCC_AHB1ENR_GPIOAEN;

   // Configure PA0 as input with pull-down
   GPIOA->MODER &= ~GPIO_MODER_MODER0;   // Clear mode bits for PA0
   GPIOA->PUPDR &= ~GPIO_PUPDR_PUPDR0;   // Clear pull-up/pull-down bits for PA0
   GPIOA->PUPDR |= GPIO_PUPDR_PUPD0_1;   // Set pull-down mode for PA0
}

void Error_Handler(void)
{
  __disable_irq();
  while (1)
  {
  }
}
